## prj.conf
```kconfig
CONFIG_PLIC=n
CONFIG_SHELL=y
CONFIG_DYNAMIC_INTERRUPTS=y
CONFIG_UART_INTERRUPT_DRIVEN=y
CONFIG_VIRTUALIZATION=y
CONFIG_BAO_IPCSHMEM=y
CONFIG_BAO_IPCSHMEM_SHELL=y
```

## src/main.c
```c
/*
 * SPDX-License-Identifier: Apache-2.0
 *
 * Workshop console app: Zephyr shell over UART.
 *
 * The shell itself runs in supervisor (VS) mode.  The `usermode` command
 * spawns a K_USER thread that executes in user (VU) mode behind the guest's
 * vsPMP, demonstrating in-guest privilege separation under the Bao hypervisor.
 * Entering the task triggers Zephyr's pre-sret vsPMP dump (see
 * z_riscv_spmp_dump_umode_state), so the user thread's vsPMP entries are
 * printed automatically as it starts.
 */

#include <zephyr/kernel.h>
#include <zephyr/shell/shell.h>

#define USER_STACK_SIZE 2048

K_THREAD_STACK_DEFINE(user_task_stack, USER_STACK_SIZE);
static struct k_thread user_task_data;

/* Runs in VU-mode.  printk() reaches the console via the k_str_out syscall;
 * k_is_user_context() / k_msleep() are likewise syscalls, all permitted from
 * user mode. */
static void user_task_entry(void *p1, void *p2, void *p3)
{
	ARG_UNUSED(p1);
	ARG_UNUSED(p2);
	ARG_UNUSED(p3);

	for (unsigned int i = 0; i < 5; i++) {
		printk("[user_task] iter=%u  user_context=%d\n",
		       i, (int)k_is_user_context());
		k_msleep(500);
	}

	printk("[user_task] done, exiting user mode\n");
}

static int cmd_usermode(const struct shell *sh, size_t argc, char **argv)
{
	ARG_UNUSED(argc);
	ARG_UNUSED(argv);

	shell_print(sh, "spawning user-mode (VU) task; watch for the vsPMP dump");

	k_tid_t tid = k_thread_create(&user_task_data, user_task_stack,
			K_THREAD_STACK_SIZEOF(user_task_stack),
			user_task_entry, NULL, NULL, NULL,
			K_PRIO_PREEMPT(5), K_USER, K_NO_WAIT);

	/* Block the shell until the user task terminates, so the prompt only
	 * returns after it is done (instead of interleaving with its output). */
	k_thread_join(tid, K_FOREVER);

	return 0;
}

SHELL_CMD_REGISTER(usermode, NULL,
		   "Spawn a task that runs in user (VU) mode behind the vsPMP",
		   cmd_usermode);

int main(void)
{
	/* Shell is started automatically by Zephyr. */
	return 0;
}
```
